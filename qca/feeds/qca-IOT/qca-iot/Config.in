## qca/feeds/qca-IOT/qca-iot/Config.in
```kconfig
config FEATURE_QCA_IOT
	bool "Enables qca-iot package for QCA402x support"
	default no
	select PACKAGE_qca-IOT
	help
		Enables qca-IOT for QCA402x support
```
